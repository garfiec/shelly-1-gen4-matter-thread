## source/components/shelly_ade7953/Kconfig
```kconfig
menu "Shelly ADE7953 power meter"

    config SHELLY_HAS_ADE7953
        bool "ADE7953 power meter fitted (I2C)"
        default n
        select SHELLY_HAS_METER
        help
            The two-channel ADE7953 of the Shelly 2PM Gen4. Channel A meters
            relay 1, channel B relay 2.

    config SHELLY_ADE7953_SDA_GPIO
        int "SDA GPIO"
        depends on SHELLY_HAS_ADE7953
        default 6

    config SHELLY_ADE7953_SCL_GPIO
        int "SCL GPIO"
        depends on SHELLY_HAS_ADE7953
        default 7

    config SHELLY_ADE7953_I2C_HZ
        int "I2C clock (Hz)"
        depends on SHELLY_HAS_ADE7953
        default 200000

    # Calibration multipliers in ESPHome's scaling (ade7953_codec.h),
    # measured on one Shelly 2PM Gen4 against a plug-in meter with a
    # resistive load (PF 1.00): 3.31 A / 117.35 V / 389 W on channel A,
    # 3.315 A / 117.37 V / 389.5 W on channel B.

    config SHELLY_ADE7953_V_MUL
        string "Voltage multiplier"
        depends on SHELLY_HAS_ADE7953
        default "0.9857"

    config SHELLY_ADE7953_IA_MUL
        string "Channel A (relay 1) current multiplier"
        depends on SHELLY_HAS_ADE7953
        default "3.795"

    config SHELLY_ADE7953_IB_MUL
        string "Channel B (relay 2) current multiplier"
        depends on SHELLY_HAS_ADE7953
        default "3.812"

    config SHELLY_ADE7953_PA_MUL
        string "Channel A (relay 1) power multiplier"
        depends on SHELLY_HAS_ADE7953
        default "-3.726"

    config SHELLY_ADE7953_PB_MUL
        string "Channel B (relay 2) power multiplier"
        depends on SHELLY_HAS_ADE7953
        default "-3.739"

endmenu
```

## source/components/shelly_ade7953_probe/Kconfig
```kconfig
menu "Shelly ADE7953 probe"

    config SHELLY_ADE7953_PROBE
        bool "Read the ADE7953 power meter (read only, for bring-up)"
        default n
        depends on SHELLY_HW_SNAPSHOT
        help
            After Matter starts, read the ADE7953's registers over I2C into the
            hardware snapshot, once in full and then the measurements every
            minute. Never writes the chip. For collecting data before a board
            has metering.

    config SHELLY_ADE7953_SDA_GPIO
        int "SDA GPIO"
        depends on SHELLY_ADE7953_PROBE
        default 6

    config SHELLY_ADE7953_SCL_GPIO
        int "SCL GPIO"
        depends on SHELLY_ADE7953_PROBE
        default 7

    config SHELLY_ADE7953_I2C_HZ
        int "I2C clock (Hz)"
        depends on SHELLY_ADE7953_PROBE
        default 200000

    config SHELLY_ADE7953_PROBE_DELAY_S
        int "Seconds after Matter starts before the first read"
        depends on SHELLY_ADE7953_PROBE
        range 10 600
        default 30

endmenu
```

## source/components/shelly_app_common/Kconfig
```kconfig
menu "Shelly diagnostics"

    config SHELLY_DIAG_LOG
        bool "Diagnostics log on the Wi-Fi mode page"
        default n
        help
            Keep the last 6 KB of the log in memory that survives a restart,
            and show it on the Wi-Fi maintenance page (Diagnostics log). It
            also logs heap and Thread/IP state every few seconds while pairing,
            and freezes the log 5 s after a failed pairing. Costs 6 KB of heap
            for the whole run. For troubleshooting builds only: see docs/BUILDING.md.

endmenu

menu "Shelly device type"

    # What the relay can be for, chosen on the Wi-Fi mode page
    # (device_profile.h). A build without Wi-Fi mode is always its default
    # type. One build per device is packaged once per Matter Product ID, each
    # with that product line's type as the default.

    config SHELLY_TYPE_OUTLET
        bool "Offer Outlet (On/Off Plug-in Unit)"
        default y

    config SHELLY_TYPE_LIGHT
        bool "Offer Light (On/Off Light)"
        default n

    config SHELLY_TYPE_OPENER
        bool "Offer Garage door opener (a toggle is a pulse)"
        default n
        help
            For a relay with a dry contact only.

    config SHELLY_OPENER_CONTACT_SENSOR
        bool "The Opener reads a door contact sensor on SW"
        depends on SHELLY_TYPE_OPENER
        default n
        help
            The Shelly 1 Gen4 Opener: SW is a door sensor, reported as a Matter
            Contact Sensor endpoint, and never switches the relay. Without it
            (a mains-powered board, whose SW carries mains voltage) the Opener
            has the Outlet's endpoints and the wall switch modes.

    config SHELLY_TYPE_LIGHT_SWITCH
        bool "Offer Light Switch (SW drives bound lights)"
        default n

    choice SHELLY_DEFAULT_TYPE
        prompt "Default device type"
        default SHELLY_DEFAULT_TYPE_OUTLET
        help
            The type of a device with none saved: a fresh install, or one
            updated from a build of a single type (this product line's).

        config SHELLY_DEFAULT_TYPE_OUTLET
            bool "Outlet"
            depends on SHELLY_TYPE_OUTLET
        config SHELLY_DEFAULT_TYPE_LIGHT
            bool "Light"
            depends on SHELLY_TYPE_LIGHT
        config SHELLY_DEFAULT_TYPE_OPENER
            bool "Garage door opener"
            depends on SHELLY_TYPE_OPENER
        config SHELLY_DEFAULT_TYPE_LIGHT_SWITCH
            bool "Light Switch"
            depends on SHELLY_TYPE_LIGHT_SWITCH
    endchoice

    config SHELLY_PULSE_MS
        int "Opener pulse length (ms)"
        depends on SHELLY_TYPE_OPENER
        default 500
        range 100 5000
        help
            How long the relay stays closed for one trigger in opener mode.

endmenu
```

## source/components/shelly_hw_snapshot/Kconfig
```kconfig
menu "Shelly hardware snapshot"

    config SHELLY_HW_SNAPSHOT
        bool "Record a hardware snapshot for the Wi-Fi mode page"
        default n
        help
            For bringing up a board: every 10 s of a normal boot, record the
            relay and input pins, the button, the temperature sensors, the heap
            and the power-meter probe's readings in memory that survives the
            restart into Wi-Fi mode, where the page shows them (/hw.json).
            Costs about 450 bytes of RTC memory and a 3 KB task. Reads only.

endmenu
```

## source/components/shelly_maintenance/Kconfig
```kconfig
menu "Shelly Wi-Fi maintenance mode"

    config SHELLY_MAINTENANCE
        bool "Wi-Fi maintenance mode (hold the button 5 s)"
        default y
        help
            Holding the button 5 s restarts the device into a boot of its own
            with Matter and Thread off: it runs an open Wi-Fi network and a
            web page at 192.168.33.1 that installs a firmware update (the
            Matter .ota file). See docs/BUTTON-AND-LED.md and docs/UPDATING.md.
            Without it, the 5 s hold is refused.

    config SHELLY_MAINTENANCE_IDLE_TIMEOUT_S
        int "Return to normal after this long with the page closed (s)"
        depends on SHELLY_MAINTENANCE
        default 600
        range 60 3600

    config SHELLY_FACTORY_DUMP
        bool "Download Shelly's stock data partitions from the page (read only)"
        depends on SHELLY_MAINTENANCE
        default n
        help
            Adds GET /part?name=... to the Wi-Fi mode page: a read-only copy of
            one of the stock regions this firmware never uses (shelly, fs_0,
            fs_1, zb_storage), to study what Shelly stores there, such as
            factory calibration. Never this firmware's own nvs. The shelly
            partition may hold the device's own keys and the Wi-Fi mode
            network is open, so this is for boards being brought up only.

endmenu
```

## source/components/shelly_metering/Kconfig
```kconfig
menu "Shelly metering"

    config SHELLY_HAS_METER
        bool
        default n
        help
            Set (selected) by a board's meter option, SHELLY_HAS_BL0942 or
            SHELLY_HAS_ADE7953: builds the metering, electrical protection
            and calibration code.

endmenu
```

## source/components/shelly_protection/Kconfig
```kconfig
menu "Shelly electrical protection"

    # Only used on boards with a power meter (SHELLY_HAS_METER). The
    # defaults suit the UL-rated Shelly 1PM Gen4 (15 A, 120 V). This is
    # secondary protection: the home's breaker is the primary protection.
    # See docs/PROTECTION.md.

    config SHELLY_PROT_RATED_CURRENT_MA
        int "Rated current per relay (mA)"
        default 15000

    config SHELLY_PROT_TOTAL_RATED_CURRENT_MA
        int "Rated current of the whole device (mA), 0 for none"
        default 0
        help
            For a board with more than one relay and a limit on their sum
            (the Shelly 2PM Gen4: 10 A per channel, 16 A total). A second
            I²t model, with the same pickup margin and trip times scaled to
            this rating, runs on the sum of the closed relays' currents and
            trips every relay. Ignored on a single-relay board.

    config SHELLY_PROT_PICKUP_PERCENT
        int "I²t pickup (% of rated current)"
        default 110
        help
            Heat builds only above this current. The margin covers meter
            calibration error, so a load at the rated current never trips.

    config SHELLY_PROT_I2T_K_A2S
        int "I²t trip threshold (A²s)"
        default 2800
        help
            With the defaults: about 54s at 18 A, 12s at 22.5 A, 4.6s at
            29.7 A (the 1PM meter's full scale). It scales with the square
            of the rated current for the same trip times.

    config SHELLY_PROT_I2T_TAU_S
        int "I²t cooling time constant (s)"
        default 300

    config SHELLY_PROT_OV_SUSTAIN_S
        int "Overvoltage duration before a trip (s)"
        default 5

    config SHELLY_PROT_OV_RECOVER_S
        int "Voltage in range before an overvoltage restore (s)"
        default 30

    config SHELLY_PROT_COOLDOWN_MS
        int "Turn-on refusal after a trip (ms)"
        default 2000

    config SHELLY_PROT_METER_LOST_S
        int "No meter frame before the meter-lost alert (s)"
        default 5

endmenu
```

## source/components/shelly_relay/Kconfig
```kconfig
menu "Shelly relay"

    config SHELLY_CHANNELS
        int "Relay channels"
        range 1 2
        default 1
        help
            How many relays (and wall switch inputs) the board has. 1 for the
            Shelly 1, 1PM and Mini; 2 for the 2PM. The second relay's and
            switch's pins are SHELLY_RELAY2_GPIO and SHELLY_SWITCH2_GPIO in the
            variant's "Shelly board" menu.

    config SHELLY_RELAY_READBACK
        bool "Read the relay pins back"
        default n
        help
            Configure the relay pins as input and output so the diagnostics
            snapshot can show that each pad follows what was written. Does
            not change what the relay does.

endmenu
```

## source/components/shelly_switch_input/Kconfig
```kconfig
menu "Shelly wall switch input"

    config SHELLY_SWITCH_ACTIVE_HIGH
        bool "SW reads HIGH when the switch is on (pressed)"
        default y
        help
            Which level of the SW input means the wall switch is on, or a push
            button is pressed. Only the Follow and Push button switch modes use
            it (docs/BUTTON-AND-LED.md, Wall switch modes); Toggle acts on any
            change. The default comes from the hardware-tested ESPHome
            configuration for these boards (SW not inverted); it is not verified
            with this firmware. If Follow runs backwards, turn this off.

endmenu
```

## source/components/shelly_thermal/Kconfig
```kconfig
menu "Shelly thermal protection"

    config SHELLY_THERMAL_DIE_TRIP_C
        int "Die temperature trip (°C)"
        default 75
        help
            Turn the relay off when the ESP32-C6 die stays above this
            temperature for SHELLY_THERMAL_SUSTAIN_S seconds. Governs on
            boards without an NTC, and on NTC boards only while the NTC is
            open circuit.

    config SHELLY_THERMAL_DIE_CLEAR_C
        int "Die temperature clear (°C)"
        default 65
        help
            Allow turn-on again once the die drops below this temperature.

    config SHELLY_THERMAL_NTC_TRIP_C
        int "Board NTC trip (°C)"
        default 90
        help
            Turn the relay off when the board NTC stays above this
            temperature for SHELLY_THERMAL_SUSTAIN_S seconds.

    config SHELLY_THERMAL_NTC_CLEAR_C
        int "Board NTC clear (°C)"
        default 75

    config SHELLY_THERMAL_SUSTAIN_S
        int "Over-temperature duration before a trip (s)"
        default 10

endmenu
```

## source/shelly-1-gen4/light/main/Kconfig.projbuild
```kconfig
menu "Example Configuration"

    config ENABLE_MEMORY_PROFILING
        bool "Enable Memory Profiling"
        default n
        help
            Enable this option to include memory profiling features in the example.
            This will allow you to monitor memory usage during runtime.

endmenu

menu "Shelly board"

    # Shelly 1 Gen4 pin map, PCB v0.1.2. See docs/GPIO.md.

    config SHELLY_RELAY_GPIO
        int "Relay GPIO (active high)"
        default 5

    config SHELLY_LED_GPIO
        int "Status LED GPIO"
        default 15

    config SHELLY_LED_ACTIVE_LOW
        bool "Status LED is active low"
        default y

    config SHELLY_BUTTON_GPIO
        int "Button GPIO"
        default 4

    config SHELLY_BUTTON_ACTIVE_LOW
        bool "Button is active low"
        default y

    config SHELLY_SWITCH_GPIO
        int "SW terminal GPIO"
        default 10

endmenu
```

## source/shelly-1-mini-gen4/app/Kconfig.app
```kconfig
# Shared by every Shelly 1 Mini Gen4 product line (main/Kconfig.projbuild
# sources it).

menu "Example Configuration"

    config ENABLE_MEMORY_PROFILING
        bool "Enable Memory Profiling"
        default n
        help
            Enable this option to include memory profiling features in the example.
            This will allow you to monitor memory usage during runtime.

endmenu

menu "Shelly board"

    # Shelly 1 Mini Gen4 pin map, PCB v0.1.2. See docs/GPIO.md.

    config SHELLY_HARDWARE_CODE
        string "Shelly hardware code"
        default "Mini1G4"
        help
            Shelly's own code for this hardware, as in make-webui-ota-zip.py.
            Stored in every image (shelly_hw_desc.h) so Wi-Fi maintenance mode
            refuses firmware built for a different Shelly model.

    config SHELLY_RELAY_GPIO
        int "Relay GPIO (active high)"
        default 10

    config SHELLY_LED_GPIO
        int "Status LED GPIO"
        default 5

    config SHELLY_LED_ACTIVE_LOW
        bool "Status LED is active low"
        default y

    config SHELLY_BUTTON_GPIO
        int "Button GPIO"
        default 22

    config SHELLY_BUTTON_ACTIVE_LOW
        bool "Button is active low"
        default y

    config SHELLY_SWITCH_GPIO
        int "SW terminal GPIO"
        default 12

endmenu
```
